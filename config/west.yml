## config/west.yml
```yaml
manifest:
  remotes:
    - name: zmkfirmware
      url-base: https://github.com/zmkfirmware
    - name: kumamuk-git
      url-base: https://github.com/kumamuk-git
  projects:
    - name: zmk
      remote: zmkfirmware
      revision: v0.3-branch
      import: app/west.yml
    - name: zmk-pmw3610-driver
      remote: kumamuk-git
      # pinado no SHA do main em 2026-07-08 (último commit: 2025-02-26, ball-action)
      # — evita quebra da build v0.3 se o upstream migrar o main pra ZMK v0.4/Zephyr 4.1
      revision: 5e04553ab803d24405bd45621a41310ea3050e59
  self:
    path: config
```
