#include "roBa.dtsi"

&kscan0 {
        col-gpios
            = <&xiao_d 10 GPIO_ACTIVE_HIGH>
            , <&xiao_d 9 GPIO_ACTIVE_HIGH> 
            , <&xiao_d 8 GPIO_ACTIVE_HIGH> 
            , <&xiao_d 7 GPIO_ACTIVE_HIGH> 
            , <&gpio0 10 GPIO_ACTIVE_HIGH>
            , <&gpio0 9 GPIO_ACTIVE_HIGH>
            ;
};

&left_encoder {
    status = "okay";

    /* 15 detents/volta × 4 pulsos por detent = 60 (confirmado na prática:
     * com steps=30 cada detent dava 2 eventos). Com triggers-per-rotation=15
     * no dtsi, 1 detent físico = exatamente 1 evento. */
    steps = <60>;
};
